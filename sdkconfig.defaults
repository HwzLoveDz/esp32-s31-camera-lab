## sdkconfig.defaults
```kconfig
# Application-only camera configuration for ESP32-S31-Korvo-1.
# Board hardware defaults are loaded before this file by CMakeLists.txt.
CONFIG_IDF_TARGET="esp32s31"
CONFIG_PARTITION_TABLE_CUSTOM=y
CONFIG_PARTITION_TABLE_CUSTOM_FILENAME="partitions.csv"
CONFIG_PARTITION_TABLE_OFFSET=0x8000
CONFIG_ESPTOOLPY_FLASHMODE_DIO=y
CONFIG_ESPTOOLPY_FLASHFREQ_80M=y
CONFIG_ESPTOOLPY_FLASHSIZE_16MB=y
# CONFIG_BT_ENABLED is not set
CONFIG_COMPILER_OPTIMIZATION_SIZE=y
CONFIG_FREERTOS_HZ=1000

# Match the validated PSRAM/display memory configuration.
CONFIG_SPIRAM=y
CONFIG_SPIRAM_XIP_FROM_PSRAM=y
CONFIG_SPIRAM_MALLOC_ALWAYSINTERNAL=0
CONFIG_SPIRAM_TRY_ALLOCATE_WIFI_LWIP=y
CONFIG_SPIRAM_ALLOW_BSS_SEG_EXTERNAL_MEMORY=y
CONFIG_SPIRAM_ALLOW_NOINIT_SEG_EXTERNAL_MEMORY=y

# UVC descriptors and IN endpoint bandwidth.
CONFIG_USB_HOST_CONTROL_TRANSFER_MAX_SIZE=4096
CONFIG_USB_HOST_HW_BUFFER_BIAS_IN=y

# Face detector + MobileFaceNet weights are embedded in the app partition.
CONFIG_FLASH_HUMAN_FACE_DETECT_MSRMNP_S8_V1=y
CONFIG_HUMAN_FACE_DETECT_MSRMNP_S8_V1=y
CONFIG_HUMAN_FACE_DETECT_MODEL_IN_FLASH_RODATA=y
CONFIG_FLASH_HUMAN_FACE_FEAT_MFN_S8_V1=y
CONFIG_HUMAN_FACE_FEAT_MFN_S8_V1=y
CONFIG_HUMAN_FACE_FEAT_MODEL_IN_FLASH_RODATA=y
CONFIG_PIX_CVT_RGB565_TO_RGB888_SUPPORT=y
CONFIG_PIX_CVT_RGB888_TO_RGB888_SUPPORT=y
# CONFIG_PIX_CVT_RGB565_TO_RGB565_SUPPORT is not set
# CONFIG_PIX_CVT_RGB565_TO_GRAY_SUPPORT is not set
# CONFIG_PIX_CVT_RGB565_TO_HSV_SUPPORT is not set
# CONFIG_PIX_CVT_RGB888_TO_RGB565_SUPPORT is not set
# CONFIG_PIX_CVT_RGB888_TO_GRAY_SUPPORT is not set
# CONFIG_PIX_CVT_RGB888_TO_HSV_SUPPORT is not set
# CONFIG_PIX_CVT_GRAY_TO_GRAY_SUPPORT is not set
# CONFIG_PIX_CVT_HSV_TO_HSV_MASK_SUPPORT is not set
# CONFIG_PIX_CVT_YUV_TO_RGB888_SUPPORT is not set
# CONFIG_PIX_CVT_YUV_TO_RGB565_SUPPORT is not set
# CONFIG_PIX_CVT_YUV_TO_GRAY_SUPPORT is not set
# CONFIG_PIX_CVT_YUV_TO_HSV_SUPPORT is not set
# CONFIG_PIX_CVT_YUV_TO_YUV_SUPPORT is not set

# DVP does not compete with USB for the JPEG decoder.
CONFIG_CAMERA_OV3660_DVP_RGB565_BE_640X480_10FPS=y
CONFIG_CAMERA_OV3660_DVP_DEFAULT_FMT_RGB565_BE_640X480_10FPS=y
# CONFIG_CAMERA_OV3660_DVP_YUV422_YUYV_640X480_10FPS is not set
# CONFIG_CAMERA_OV3660_DVP_DEFAULT_FMT_YUV422_YUYV_640X480_10FPS is not set

CONFIG_LV_CONF_SKIP=y
CONFIG_LV_USE_CLIB_MALLOC=y
CONFIG_LV_COLOR_DEPTH_16=y
# CONFIG_LV_BUILD_EXAMPLES is not set
# CONFIG_LV_BUILD_DEMOS is not set
CONFIG_LV_FONT_MONTSERRAT_14=y
CONFIG_LV_FONT_MONTSERRAT_28=y
CONFIG_LV_FONT_MONTSERRAT_32=y
CONFIG_LV_FONT_DEFAULT_MONTSERRAT_14=y
CONFIG_LV_FONT_FMT_TXT_LARGE=y
CONFIG_LV_USE_LABEL=y
CONFIG_LV_USE_BUTTON=y
CONFIG_LV_USE_CANVAS=y
CONFIG_LV_USE_IMAGE=y
CONFIG_LV_USE_FLEX=y
CONFIG_LV_USE_GRID=y
```
